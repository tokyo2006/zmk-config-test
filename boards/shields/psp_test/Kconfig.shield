## boards/shields/sofle_cirque/Kconfig.defconfig
```kconfig
if SHIELD_SOFLE_CIRQUE_RIGHT

config ZMK_KEYBOARD_NAME
	default "sofle_cirque"

config ZMK_SPLIT_ROLE_CENTRAL
	default y

endif

if SHIELD_SOFLE_CIRQUE_LEFT || SHIELD_SOFLE_CIRQUE_RIGHT

config ZMK_SPLIT
	default y

endif

if ZMK_BACKLIGHT

config PWM
    default y

config LED_PWM
    default y

endif # ZMK_BACKLIGHT
```

## boards/shields/sofle_cirque/Kconfig.shield
```kconfig
config SHIELD_SOFLE_CIRQUE_LEFT
    def_bool $(shields_list_contains,sofle_cirque_left)

config SHIELD_SOFLE_CIRQUE_RIGHT
    def_bool $(shields_list_contains,sofle_cirque_right)
```
